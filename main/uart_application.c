/**
 * @file uart_application.c
 * @author
 * @date
 * @brief
 */

//=============================================================================
// [Inclusions] ===============================================================
#include "freertos/FreeRTOS.h"
#include "freertos/task.h"

#include "cJSON.h"
#include "driver/uart.h"

#include "mqtt_Application.h"

//=============================================================================

//=============================================================================
// [Private Defines] ==========================================================
#define EX_UART_NUM 	UART_NUM_0
#define BUF_SIZE 		(1024)

//=============================================================================

//=============================================================================
// [Local Typedef] ============================================================

//=============================================================================

//=============================================================================
// [External Data Definitions] ================================================

// Const ---------------------------------------------
//----------------------------------------------------

// Vars ----------------------------------------------
//----------------------------------------------------

// Task Handlers -------------------------------------
//----------------------------------------------------

// Queue Handlers ------------------------------------
//----------------------------------------------------

// Event Group Handlers ------------------------------
//----------------------------------------------------

// Semaphore Handlers --------------------------------
//----------------------------------------------------

//=============================================================================

//=============================================================================
// [Local Data Declarations] ==================================================

// Const ---------------------------------------------
//----------------------------------------------------

// Vars ----------------------------------------------
//----------------------------------------------------

// Task Handlers -------------------------------------
//----------------------------------------------------

// Queue Handlers ------------------------------------
//----------------------------------------------------

// Event Group Handlers ------------------------------
//----------------------------------------------------

// Semaphore Handlers --------------------------------
//----------------------------------------------------

//=============================================================================

//=============================================================================
// [Local Function Declarations] ==============================================

//=============================================================================

//=============================================================================
// [FreeRTOS Task Definitions] ================================================

static void uart_event_task(void *pvParameters)
{
    uint8_t buff[128] = {0};
    int len = 0;

    char * payload = NULL;
    cJSON * root = NULL;

    while(1)
    {
    	memset(buff, 0, sizeof(buff));

    	len = uart_read_bytes(EX_UART_NUM, buff, sizeof(buff), 0);

    	if (len > 0)
    	{
    		root = cJSON_CreateObject();

    		cJSON_AddItemToObject(root, "str", cJSON_CreateString((char*)buff));

    		payload = cJSON_Print(root);

    		/* free all objects in root and root itself */
    		cJSON_Delete(root);

    		if (true == mqtt_enter_critical())
    		{
    			esp_mqtt_client_publish(mqtt_client, "test1", payload, 0, 0, 0);
    			mqtt_exit_critical();
    		}

    		free(payload);
    	}

    	portYIELD();
    }
}


//=============================================================================

//=============================================================================
// [Local Function Definitions] ===============================================

//=============================================================================

//=============================================================================
// [External Function Definition] =============================================

void uart_init(void)
{
	uart_config_t uart_config = {
			.baud_rate = 115200,
			.data_bits = UART_DATA_8_BITS,
			.parity = UART_PARITY_DISABLE,
			.stop_bits = UART_STOP_BITS_1,
			.flow_ctrl = UART_HW_FLOWCTRL_DISABLE,
			.source_clk = UART_SCLK_APB,
	};

	uart_driver_install(EX_UART_NUM, BUF_SIZE * 2, BUF_SIZE * 2, 20, NULL, 0);
	uart_param_config(EX_UART_NUM, &uart_config);

	uart_set_pin(EX_UART_NUM, UART_PIN_NO_CHANGE, UART_PIN_NO_CHANGE, UART_PIN_NO_CHANGE, UART_PIN_NO_CHANGE);

    xTaskCreate(uart_event_task, "uart_event_task", configMINIMAL_STACK_SIZE * 4, NULL, tskIDLE_PRIORITY + 1, NULL);
}
// End void uart_init(void)

//=============================================================================

//====================== [End Document] =======================================
